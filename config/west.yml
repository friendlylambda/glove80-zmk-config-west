## config/west.yml
```yaml
manifest:
  remotes:
    - name: moergo-sc
      url-base: https://github.com/moergo-sc
    - name: patched-zmk
      url-base: https://github.com/caksoylar
  projects:
    - name: zmk
      remote: patched-zmk
      revision: behaviors/sticky-key-positions-moergo
      import: app/west.yml
  self:
    path: config
```
